## config/west.yml
```yaml
manifest:
  projects:
    - name: zmk
      url: https://github.com/urob/zmk
      revision: feature/nice_view_adapter
      import: app/west.yml
  self:
    path: config
```
